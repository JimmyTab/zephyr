## prj.conf
```kconfig
# nothing here
CONFIG_RISCV_PMP=n
CONFIG_RISCV_MMU=y
CONFIG_HEAP_MEM_POOL_SIZE=131072
CONFIG_LOG=y
CONFIG_LOG_MODE_IMMEDIATE=y
CONFIG_LOG_DEFAULT_LEVEL=4
CONFIG_CONSOLE=y
CONFIG_UART_CONSOLE=y
CONFIG_PRINTK=y
CONFIG_KERNEL_VM_BASE=0xA000000
CONFIG_KERNEL_VM_SIZE=0x10000000
```

## src/main.c
```c
/*
 * Copyright (c) 2012-2014 Wind River Systems, Inc.
 *
 * SPDX-License-Identifier: Apache-2.0
 */

// #include <stdio.h>

// int main(void)
// {
// 	printf("Hello World! %s\n", CONFIG_BOARD_TARGET);

// 	return 0;
// }

/*----------------- Includes ---------------*/
#include <stdint.h>
#include <string.h>


#include <riscv_mmu.h>
#include <zephyr/sys/util.h>


int main () {

    for (int i=0; i < 0xFFFF ; i += KB(4)) {
        riscv_map_page((uintptr_t)&i,(uintptr_t)&i,0);
    }
}
```
